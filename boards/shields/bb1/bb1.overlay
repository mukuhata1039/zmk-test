#include <dt-bindings/zmk/matrix_transform.h>

/ {
  chosen {
    zmk,kscan = &mock_kscan;
    zmk,matrix_transform = &default_transform;
  };

  mock_kscan: mock_kscan_0 {
    compatible = "zmk,kscan-mock";
    rows = <1>;
    columns = <1>;
    events = <0>;
  };

  default_transform: keymap_transform_0 {
    compatible = "zmk,matrix-transform";
    rows = <1>;
    columns = <1>;
    map = <RC(0,0)>;
  };
};
