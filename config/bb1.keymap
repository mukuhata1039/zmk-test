#include <dt-bindings/zmk/keys.h>
#include <behaviors.dtsi>

/ {
    keymap {
        compatible = "zmk,keymap";

        default_layer {
            bindings = <
                &kp A
            >;
        };
    };
};
